## drivers/amlogic/hardware/tvin/Kconfig
```kconfig
#
# Amlogic tvin devices configuration
#

menuconfig TVIN
	tristate "Amlogic TVIN support"
	default n

if TVIN

source "drivers/amlogic/hardware/tvin/vdin/Kconfig"
source "drivers/amlogic/hardware/tvin/tvafe/Kconfig"
source "drivers/amlogic/hardware/tvin/hdmirx/Kconfig"
source "drivers/amlogic/hardware/tvin/bt656/Kconfig"
source "drivers/amlogic/hardware/tvin/csi/Kconfig"
source "drivers/amlogic/hardware/tvin/viu/Kconfig"
source "drivers/amlogic/hardware/tvin/it660x/Kconfig"
source "drivers/amlogic/hardware/tvin/isp/Kconfig"
source "drivers/amlogic/hardware/tvin/vdin_ctrl/Kconfig"
endif
```
